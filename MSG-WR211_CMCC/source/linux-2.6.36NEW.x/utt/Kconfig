## MSG-WR211_CMCC/source/linux-2.6.36NEW.x/utt/Kconfig
```kconfig
menu "UTT Module"

choice
        prompt "UTT_MODEL"

        config  UTT_NV840G
        bool "nv840G"

		config UTT_WX100
		bool "WX100"

        config  UTT_NV510V2
        bool "nv510v2"

        config  UTT_NV510V4
        bool "nv510v4"


	config  UTT_NV520V2
	bool "nv520v2"

	config  UTT_NV640EV2
	bool "nv640Ev2"

	config  UTT_NV810V2
	bool "nv810v2"

	config  UTT_NV810V3
	bool "nv810v3"

        config  UTT_NV811V4
        bool "nv811v4"

        config  UTT_NV821V2
        bool "nv821v2"

        config  UTT_NV841V4
        bool "nv841v4"

	config  UTT_NV810V4
	bool "nv810v4"

	config  UTT_NV830V3
	bool "nv830v3"

	config  UTT_NV840V2
	bool "nv840v2"

	config  UTT_NV840V4
	bool "nv840v4"

        config  UTT_NV1540
        bool "nv1540"

        config  UTT_NV3520G
        bool "nv3520G"

	config UTT_WX1000
	bool "WX1000"
	
	config  UTT_NV510W
        bool "nv510W"

	config  UTT_NV520W
        bool "nv520W"
	

	config  UTT_NV520WV3
        bool "nv520Wv3"

	config  UTT_NV842WV3
        bool "nv842Wv3"

	config  UTT_NV1800N
        bool "nv1800N"

	config  UTT_NV512WV2
        bool "nv512Wv2"

	config  UTT_NV515W
        bool "nv515W"

	config  UTT_NV521GV2
        bool "nv521Gv2"

	config  UTT_NV750GW
        bool "nv750GW"

	config UTT_NV512WV3
	bool "nv512Wv3"

	config UTT_NV518WV3
	bool "nv518Wv3"

	config UTT_750W
	bool "750W"

	config UTT_1220GW
	bool "1220GW"

	config UTT_1220V2
	bool "1220v2"

	config UTT_U1000NV2
	bool "u1000N"
	config UTT_U1100
	bool "u1100"

	config UTT_NV840DV3
	bool "nv840Dv3"
	
	 config UTT_NV517W
	bool "nv517W"
	
	config UTT_NV840EV3
	bool "nv840Ev3"

	config UTT_D915W
	bool "nvD915W"

	config UTT_U1900
	bool "u1900"
	
	config  UTT_NVD904W 
	bool "nvD904W"

	config UTT_A655W
        bool "A655W"

	config UTT_A310Wv2
        bool "A310Wv2"

	config UTT_A658W
	bool "A658W"

        config UTT_NVD908W
        bool "nvD908W"
endchoice

config  UTT_ROUTER_CHIP_FUNC
        bool "router chip related functions designed in kernel ( mirror or vlan  e.g.)"
        default n

config  UTT_WANPORT_SET
        bool "wan port set on vlan" 
        depends on UTT_ROUTER_CHIP_FUNC 
        default n

config  UTT_RDD_MIRROR
        bool "reduced mirror config" 
        depends on UTT_ROUTER_CHIP_FUNC 
        default n

config  UTT_RDD_PVLAN
        bool "reduced port-based vlan" 
        depends on UTT_ROUTER_CHIP_FUNC 
        default n

config  UTT_PERFORMANCE
         bool "utt performance"
	 
config  UTT_TOMAX
        bool "ToMAX production"
        default n

config PERFORMANCE_OPTIMIZATION
	 bool "UTT performance optimization"
	 default n
	 ---help---
	     UTT performance optimization control macro

config  UTT_PANIC_DEBUG
	bool "save error information to flash when system come down"
	default n

config  UTT_FLAG
    	bool "utt flag ,just mark this code modified by utt"
	default y

config	UTT_MAC_FC2FEF
	bool "MAC start with FC-2F-EF"
	default n

config	CHINA_MAC_04714B
	bool "MAC start with 04-71-4B"
	default n
config	UTT_MAC_C850E9
	bool "MAC start with C8-50-E9"
	default n
config  RAISECOM_A30W
    bool "RAISECOM BOOT"
    default n
config  UTT_TIME_GRP
    bool "TIME_GRP"
    default n
config  SKYWORTH
    bool "SKYWORTH"
    default n
config UTT_KNOWIFI
	bool "enable knowifi wifi reject"
	default n
config WAN_PORT3
    bool "port3 wan"
    default n
config UTT_MT7628_FLASH_SOFTEN
         bool "7628 flash encode"
         default n

if PERFORMANCE_OPTIMIZATION
    source "utt/config/Kconfig"
    source "utt/common/Kconfig"
endif

endmenu
```

## MSG-WR211_CMCC/source/linux-2.6.36NEW.x/utt/common/Kconfig
```kconfig
if PERFORMANCE_OPTIMIZATION

config UTT_TIME_SET_MAX
        int "Maximum number of utt time sets"
	default 10
	range 2 32
	depends on PERFORMANCE_OPTIMIZATION
	help
	    You can define here default value of the maximum number 
	    of utt time sets for the kernel.

	    The value can be overriden by the 'maxTimeSets' module
	    parameter of the 'utt_time_set' module.
endif
```

## linux-2.6.36NEW.x/utt/config/Kconfig
```kconfig
if PERFORMANCE_OPTIMIZATION
	config UTT_TIME_GRP
	    bool "time group function"
	    default n
	    help 
		start up time group function,you should edit "needChangeFile/linux-config".

	config UTT_NF_DNS_FILTER
	    bool "dns filter"
	    default n
	    help 
		start up dns filter function,you should edit "needChangeFile/linux-config".

	config UTT_NF_PPPOE_LIMIT
	    bool "PPPoE limit switch macro in kernel"
	    default n
	    help 
		start up PPPoE limit function,you should edit "needChangeFile/linux-config".
endif
```
